## conf/layer.conf
```bitbake
# SPDX-License-Identifier: MIT

BBPATH .= ":${LAYERDIR}"

BBFILES += "${LAYERDIR}/recipes-*/*/*.bb \
            ${LAYERDIR}/recipes-*/*/*.bbappend"

BBFILE_COLLECTIONS += "rowanos_frameworks"
BBFILE_PATTERN_rowanos_frameworks = "^${LAYERDIR}/"
BBFILE_PRIORITY_rowanos_frameworks = "20"

LAYERDEPENDS_rowanos_frameworks = "core"
LAYERSERIES_COMPAT_rowanos_frameworks = "scarthgap"
```
